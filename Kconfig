## Kconfig
```kconfig
#
# Copyright (c) 2022 The ZMK Contributors
# SPDX-License-Identifier: MIT
#

config BOARD_ERGODASH_MINI_LEFT
    bool

config BOARD_ERGODASH_MINI_RIGHT
    bool
```

## config/Kconfig.board
```kconfig
#
# Copyright (c) 2022 Darryl deHaan
# SPDX-License-Identifier: MIT
#

config BOARD_ERGODASH_MINI_LEFT
    bool "ergodash_mini left"
    depends on SOC_NRF52840_QIAA


config BOARD_ERGODASH_MINI_RIGHT
    bool "ergodash_mini right"
    depends on SOC_NRF52840_QIAA
```
